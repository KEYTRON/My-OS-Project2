/* kernel.ld */
OUTPUT_FORMAT(elf32-i386)
ENTRY(start)        /* Указываем начальную точку входа */
PROVIDE(start = 0x00100000);
SECTIONS
{
    . = 0x00100000;  /* Адрес загрузки ядра в память */
    .text : { *(.text) }  /* Секция с кодом: сюда попадает весь исполняемый код */
    .data : { *(.data) }  /* Секция с данными: инициализированные переменные */
    .bss  : { *(.bss) }   /* Секция BSS: неинициализированные переменные (обнуляются) */
}

